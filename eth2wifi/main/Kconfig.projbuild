## eth2wifi/main/Kconfig.projbuild
```kconfig
menu "Bridge x SC635"


config USA_MS
    bool "Usa macchina a stati"
    default n
    help
        Se vero usa una macchina a stati

config MEZZA_BANDA
    bool "Usa solo la banda di un canale"
    default n
    help
        Se vero ...

endmenu
```
